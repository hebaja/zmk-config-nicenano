&pro_micro {
	oled_display: oled_display {
		compatible = "ssd1306";
		label = "SSD1306";
		height = <32>;
		width = <128>;
		segment-offset = <0>;
		page-offset = <0>;
		rotation = <180>;
		i2c = <&i2c1>;
	};

	ws2812_strip: ws2812_strip {
		compatible = "worldsemi,ws2812-spi";
		label = "WS2812";
		spi = <&spi1>;
		chain-length = <12>;  // Change this based on the number of LEDs
	};
};
